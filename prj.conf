## CMakeLists.txt
```
# SPDX-License-Identifier: Apache-2.0

cmake_minimum_required(VERSION 3.20.0)
find_package(Zephyr REQUIRED HINTS $ENV{ZEPHYR_BASE})
project(blinky)

target_sources(app PRIVATE src/main.c
                           src/HalGpio.c
                           src/HalPwm.c
                           src/HalTim.c
                           src/SrvScheduler.c
                           src/SrvMenu.c
                           src/UtilGen.c
                           src/AppEncoder.c
                           src/AppMotor.c
                           src/App.c)
```

## prj.conf
```kconfig
CONFIG_GPIO=y
CONFIG_NRFX_TIMER0=y
CONFIG_NRFX_PWM0=y

CONFIG_CONSOLE=y
CONFIG_CONSOLE_SUBSYS=y
CONFIG_CONSOLE_GETCHAR=y
CONFIG_NEWLIB_LIBC_FLOAT_PRINTF=y
CONFIG_NEWLIB_LIBC=y
```

## src/main.c
~~~~c
#include "App.h"

 int main(void)
 {
    AppProcess();
    return 0;
 }

// #include <zephyr/kernel.h>
// #include <zephyr/drivers/uart.h>
// #include <zephyr/sys/printk.h>
// #include <zephyr/device.h>
// #include <string.h>

// #define UART_DEVICE_NODE DT_CHOSEN(zephyr_console)
// #define MAX_INPUT_LEN 32  // Max sentence length

// static const struct device *uart_dev;
// static struct k_work input_work;

// static char rx_buffer[MAX_INPUT_LEN];  // Buffer for full sentence
// static uint8_t buffer_pos = 0;         // Position in buffer

// void print_menu(void) {
//     printk("\n===== Interactive Menu =====\n");
//     printk("Type a command and press Enter:\n");
//     printk("> led on  - Turn LED ON\n");
//     printk("> led off - Turn LED OFF\n");
//     printk("> status  - Get status\n");
//     printk("> exit    - Quit\n");
//     printk("Your input: ");
// }

// // Process full command from buffer
// void process_input(struct k_work *work) 
// {
//     rx_buffer[buffer_pos] = '\0';  // Null-terminate the string
//     printk("\nReceived: %s\n", rx_buffer);

//     if (strcmp(rx_buffer, "led on") == 0) {
//         printk("Turning LED ON...\n");
//         // Add LED ON logic here
//     } else if (strcmp(rx_buffer, "led off") == 0) {
//         printk("Turning LED OFF...\n");
//         // Add LED OFF logic here
//     } else if (strcmp(rx_buffer, "status") == 0) {
//         printk("System is running normally.\n");
//     } else if (strcmp(rx_buffer, "exit") == 0) {
//         printk("Exiting...\n");
//         return;
//     } else {
//         printk("Unknown command: %s\n", rx_buffer);
//     }

//     // Reset buffer for new input
//     buffer_pos = 0;
//     memset(rx_buffer, 0, MAX_INPUT_LEN);
//     print_menu();
// }

// // UART interrupt handler (non-blocking input)
// void uart_interrupt_handler(const struct device *dev, void *user_data) {
//     char received_char;
//     if (!uart_irq_update(dev)) {
//         return;
//     }

//     if (uart_irq_rx_ready(dev)) {
//         uart_poll_in(dev, &received_char);

//         if (received_char == '\n' || received_char == '\r') {  // Enter key pressed
//             k_work_submit(&input_work);  // Process input
//         } else if (received_char == '\b' && buffer_pos > 0) {  // Handle backspace
//             buffer_pos--;
//             rx_buffer[buffer_pos] = '\0';
//         } else if (buffer_pos < MAX_INPUT_LEN - 1) {  // Add character to buffer
//             rx_buffer[buffer_pos++] = received_char;
//         }
//     }
// }

// void main(void) {
//     uart_dev = DEVICE_DT_GET(UART_DEVICE_NODE);
//     if (!device_is_ready(uart_dev)) {
//         printk("UART device not ready!\n");
//         return;
//     }

//     // Initialize work queue for processing input
//     k_work_init(&input_work, process_input);

//     // Configure UART for interrupt-driven operation
//     uart_irq_callback_user_data_set(uart_dev, uart_interrupt_handler, NULL);
//     uart_irq_rx_enable(uart_dev);

//     printk("\nSerial Interactive Menu Started!\n");
//     print_menu();

//     while (1) {
//         k_sleep(K_SECONDS(1));  // Keep main loop running
//         printk(".");  // Simulate background process
//     }
// }



/*
### **🚀 Sending a Full Sentence Over Serial (UART) in nRF5340**
Yes! Instead of **reading a single character**, you can **buffer a full sentence** (up to `N` characters) and process it once the user **presses Enter (`\n`)**.

---

## **✅ 1️⃣ Key Changes for Sentence Input**
| **Feature** | **How It Works?** |
|------------|------------------|
| **Buffer Input Instead of Single Char** | Stores received characters in an array (`rx_buffer[]`). |
| **Detect `\n` (Enter Key)** | Processes input when user presses **Enter (`\n`)**. |
| **Ignore Backspace (`\b`)** | Allows correction during typing. |
| **Limit Input Length** | Avoids buffer overflow. |

---

## **✅ 2️⃣ Updated Code to Read a Sentence**
### **📌 `main.c` (Non-Blocking UART with Sentence Input)**
```c
#include <zephyr/kernel.h>
#include <zephyr/drivers/uart.h>
#include <zephyr/sys/printk.h>
#include <zephyr/device.h>
#include <string.h>

#define UART_DEVICE_NODE DT_CHOSEN(zephyr_console)
#define MAX_INPUT_LEN 32  // Max sentence length

static const struct device *uart_dev;
static struct k_work input_work;

static char rx_buffer[MAX_INPUT_LEN];  // Buffer for full sentence
static uint8_t buffer_pos = 0;         // Position in buffer

void print_menu(void) {
    printk("\n===== Interactive Menu =====\n");
    printk("Type a command and press Enter:\n");
    printk("> led on  - Turn LED ON\n");
    printk("> led off - Turn LED OFF\n");
    printk("> status  - Get status\n");
    printk("> exit    - Quit\n");
    printk("Your input: ");
}

// Process full command from buffer
void process_input(struct k_work *work) {
    rx_buffer[buffer_pos] = '\0';  // Null-terminate the string
    printk("\nReceived: %s\n", rx_buffer);

    if (strcmp(rx_buffer, "led on") == 0) {
        printk("Turning LED ON...\n");
        // Add LED ON logic here
    } else if (strcmp(rx_buffer, "led off") == 0) {
        printk("Turning LED OFF...\n");
        // Add LED OFF logic here
    } else if (strcmp(rx_buffer, "status") == 0) {
        printk("System is running normally.\n");
    } else if (strcmp(rx_buffer, "exit") == 0) {
        printk("Exiting...\n");
        return;
    } else {
        printk("Unknown command: %s\n", rx_buffer);
    }

    // Reset buffer for new input
    buffer_pos = 0;
    memset(rx_buffer, 0, MAX_INPUT_LEN);
    print_menu();
}

// UART interrupt handler (non-blocking input)
void uart_interrupt_handler(const struct device *dev, void *user_data) {
    char received_char;
    if (!uart_irq_update(dev)) {
        return;
    }

    if (uart_irq_rx_ready(dev)) {
        uart_poll_in(dev, &received_char);

        if (received_char == '\n' || received_char == '\r') {  // Enter key pressed
            k_work_submit(&input_work);  // Process input
        } else if (received_char == '\b' && buffer_pos > 0) {  // Handle backspace
            buffer_pos--;
            rx_buffer[buffer_pos] = '\0';
        } else if (buffer_pos < MAX_INPUT_LEN - 1) {  // Add character to buffer
            rx_buffer[buffer_pos++] = received_char;
        }
    }
}

void main(void) {
    uart_dev = DEVICE_DT_GET(UART_DEVICE_NODE);
    if (!device_is_ready(uart_dev)) {
        printk("UART device not ready!\n");
        return;
    }

    // Initialize work queue for processing input
    k_work_init(&input_work, process_input);

    // Configure UART for interrupt-driven operation
    uart_irq_callback_user_data_set(uart_dev, uart_interrupt_handler, NULL);
    uart_irq_rx_enable(uart_dev);

    printk("\nSerial Interactive Menu Started!\n");
    print_menu();

    while (1) {
        k_sleep(K_SECONDS(1));  // Keep main loop running
        printk(".");  // Simulate background process
    }
}
```

---

## **✅ 3️⃣ Key Improvements**
| **Feature** | **How It Works?** |
|------------|------------------|
| **Full sentence input (up to 32 chars)** | User types a full command before processing. |
| **Press `Enter` to send the command** | `\n` or `\r` triggers command execution. |
| **Handles Backspace (`\b`)** | Allows user to correct input. |
| **Processes commands asynchronously** | Uses `k_work_submit()` to handle input in background. |

---

## **✅ 4️⃣ Example Output**
```
===== Interactive Menu =====
Type a command and press Enter:
> led on  - Turn LED ON
> led off - Turn LED OFF
> status  - Get status
> exit    - Quit
Your input: . . . 

led on
Received: led on
Turning LED ON...

===== Interactive Menu =====
Your input: . . . 

status
Received: status
System is running normally.

===== Interactive Menu =====
Your input: 
```
✅ **Fully interactive, non-blocking menu!**  
✅ **Handles full sentences instead of characters!**  

---

## **📌 Summary**
| **Feature** | **Benefit** |
|------------|------------|
| **Non-blocking UART (`uart_irq_rx_enable()`)** | Allows serial input **without blocking the main loop** |
| **Full Sentence Input Buffer (`rx_buffer[]`)** | User **types full command and presses Enter** |
| **Work Queue (`k_work_submit()`)** | Processes input asynchronously |
| **Handles Backspace (`\b`)** | Allows user to **edit before sending** |

---

## **🚀 Next Steps**
🔹 **Want to add real LED control logic?**  
🔹 **Need a menu for controlling motor speed?**  
🔹 **Want to store settings in Flash memory?**  

Let me know how I can assist! 🚀🔥

*/
~~~~

## include/HalGpio.h
```c
/******************************************************************************/

/**
 *  \file    HalGpio.h
 *  \author  https://github.com/gwyacnt/
 *  \brief   GPIO component definitions
 *
 *  \remarks 
 */

 #ifndef __HAL_GPIO_H__
 #define __HAL_GPIO_H__
 
 #include <stdint.h>
 #include <stdbool.h>
 #include "driver/gpio.h"

 /******************************************************************************/
 /* Exported defines and types                                                 */
 /******************************************************************************/
 // Most ESP32 dev kits have an LED on GPIO 2
 #define PIN_LED_DEVKIT GPIO_NUM_2
 #define PIN_L_EN       GPIO_NUM_16
 #define PIN_R_EN       GPIO_NUM_17

 /******************************************************************************/
 /* Exported data                                                              */
 /******************************************************************************/
 
 /******************************************************************************/
 /* Exported functions                                                         */
 /******************************************************************************/
 void          HalGpio_Init     (void);
 int           HalGpio_ReadPin  (uint16_t gpio_num);
 int           HalGpio_WritePin (uint16_t gpio_num, uint32_t level);
 int           HalGpio_TogglePin(uint16_t gpio_num);
 #endif /* defined __HAL_GPIO_H__ */
```

## src/App.c
```c
#include <stdio.h>
#include "HalGpio.h"
#include "UtilGen.h"
#include "SrvScheduler.h"
#include "SrvMenu.h"
#include "HalPwm.h"
#include "HalTim.h"
#include "AppEncoder.h"
#include "AppMotor.h"
#include <zephyr/sys/printk.h>

#include <zephyr/kernel.h>
#include <zephyr/drivers/uart.h>
#include <zephyr/sys/printk.h>
#include <zephyr/device.h>
#include <string.h>

#define UART_DEVICE_NODE DT_CHOSEN(zephyr_console)
#define MAX_INPUT_LEN 32  // Max sentence length

static const struct device *uart_dev;
static struct k_work input_work;

static char rx_buffer[MAX_INPUT_LEN];  // Buffer for full sentence
static uint8_t buffer_pos = 0;         // Position in buffer
static int8_t motor_pwm = 0;

void print_menu(void) {
    printk("\n===== Interactive Menu =====\n");
    printk("Type a command and press Enter:\n");
    printk("Your input: ");
}

// Process full command from buffer
void process_input(struct k_work *work) 
{
    rx_buffer[buffer_pos] = '\0';  // Null-terminate the string
    printk("\nReceived: %s\n", rx_buffer);

    if (strcmp(rx_buffer, "led 50") == 0) 
    {
        printk("Turning LEDs 0 and 3 with 50 percent...\n");
        PWM_SetDutyCycle(HAL_PWM_CHANNEL_LED3_DEVKIT, 50);
        PWM_SetDutyCycle(HAL_PWM_CHANNEL_LED4_DEVKIT, 50);

    // } else if (strcmp(rx_buffer, "led 0") == 0) 
    // {
    //     printk("Turning LEDs 0 and 3 with 0 percent...\n");
    //     PWM_SetDutyCycle(0, 0);
    //     PWM_SetDutyCycle(3, 0);
    
    // } else if (strcmp(rx_buffer, "led 100") == 0) 
    // {
    //     printk("Turning LEDs 0 and 3 with 100 percent...\n");
    //     PWM_SetDutyCycle(0, 100);
    //     PWM_SetDutyCycle(3, 100);

    // } else if (strcmp(rx_buffer, "R100") == 0) 
    // {
    //     printk("CW 100 ...\n");
    //     AppMotor_SetSpeed(MOTOR_DIRECTION_CW, 100);
    // } else if (strcmp(rx_buffer, "R50") == 0) 
    // {
    //     printk("CW 50 ...\n");
    //     AppMotor_SetSpeed(MOTOR_DIRECTION_CW, 50);

    // } else if (strcmp(rx_buffer, "S") == 0) 
    // {
    //     printk("Stopping ...\n");
    //     AppMotor_SetSpeed(MOTOR_DIRECTION_STOPPED, 0);
    // } else if (strcmp(rx_buffer, "L50") == 0) 
    // {
    //     printk("CCW 50 ...\n");
    //     AppMotor_SetSpeed(MOTOR_DIRECTION_CCW, 50);
    // } else if (strcmp(rx_buffer, "L100") == 0) 
    // {
    //     printk("CCW 100 ...\n");
    //     AppMotor_SetSpeed(MOTOR_DIRECTION_CCW, 100);

    // } else if (strcmp(rx_buffer, "R 0") == 0) 
    // {
    //     printk("R_EN 0...\n");
    //     HalGpio_WritePin(PIN_MOTOR_R_EN, 0);
    // } else if (strcmp(rx_buffer, "R 1") == 0) 
    // {
    //     printk("R_EN 1...\n");
    //     HalGpio_WritePin(PIN_MOTOR_R_EN, 1);
    } else if (rx_buffer[0] == 's' && rx_buffer[1] == ' ') 
    {
        int speed = atoi(&rx_buffer[3]);  // Extract speed value
        if (speed >= 0 && speed <= 100)  // Validate speed range
        {
            printk("Setting motor speed to %d%%...\n", speed);
            AppMotor_SetSpeed(speed);
        } 
        else 
        {
            printk("Invalid speed value. Please enter a value between 0 and 100.\n");
        }
    } else if (strcmp(rx_buffer, "d") == 0) 
    {
        motor_pwm = motor_pwm - 20;
        printk("motor pwm = %d%%\n", motor_pwm);
        AppMotor_SetSpeed(motor_pwm);

    } else if (strcmp(rx_buffer, "status") == 0) {
        printk("System is running normally.\n");
    } else if (strcmp(rx_buffer, "exit") == 0) {
        printk("Exiting...\n");
        return;
    } else {
        printk("Unknown command: %s\n", rx_buffer);
    }

    // Reset buffer for new input
    buffer_pos = 0;
    memset(rx_buffer, 0, MAX_INPUT_LEN);
    print_menu();
}

// UART interrupt handler (non-blocking input)
void uart_interrupt_handler(const struct device *dev, void *user_data) {
    char received_char;
    if (!uart_irq_update(dev)) {
        return;
    }

    if (uart_irq_rx_ready(dev)) {
        uart_poll_in(dev, &received_char);

        if (received_char == '\n' || received_char == '\r') {  // Enter key pressed
            k_work_submit(&input_work);  // Process input
        } else if (received_char == '\b' && buffer_pos > 0) {  // Handle backspace
            buffer_pos--;
            rx_buffer[buffer_pos] = '\0';
        } else if (buffer_pos < MAX_INPUT_LEN - 1) {  // Add character to buffer
            rx_buffer[buffer_pos++] = received_char;
        }
    }
}

void tastBlinkLED(void)
{
    // static uint64_t last_time_ms = 0;  // Store last execution time
    
    // uint64_t current_time_ms = k_uptime_get();  // Get current system time
    // if (last_time_ms != 0) 
    // {
    //     uint64_t elapsed = current_time_ms - last_time_ms;
    //     printk(" - Elapsed time since last execution: %llu ms\n", elapsed);
    // }
    // last_time_ms = current_time_ms;  // Update last execution time

    HalGpio_TogglePin (PIN_LED1_DEVKIT);
}


void AppProcess(void)
{
     HalGpio_Init();
     PWM_Init();
     SrvScheduler_Init();
     SrvScheduler_AddTask(tastBlinkLED, 1000);
     SrvScheduler_Start();
     AppEncoder_Init();
     

     uart_dev = DEVICE_DT_GET(UART_DEVICE_NODE);
     if (!device_is_ready(uart_dev)) {
         printk("UART device not ready!\n");
         return;
     }
 
     // Initialize work queue for processing input
     k_work_init(&input_work, process_input);
 
     // Configure UART for interrupt-driven operation
     uart_irq_callback_user_data_set(uart_dev, uart_interrupt_handler, NULL);
     uart_irq_rx_enable(uart_dev);

     printk("\n\n=-=-=-=-=-=-=-=-=-=-=-=-=-=-=-=-=-=-=-=-=-=-=-=-=-=-=-=-=-\n\n");
     printk("\nSerial Interactive Menu Started!\n");
    //  print_menu();
    SrvMenu_Init();  
    int ch = getchar();
    if(ch == 'x')
    {
        printf("\n getchar and printf are working.");
    }

    //  AppMotor_SetTarget (AppEncoder_ConvertNumOfRotationsToPos(5));
 
     while (1) {
        SrvMenu_Process();
        // printk("\n");
        // AppMotor_DriveMotorTask();
        // k_sleep(K_SECONDS(1));  // Keep main loop running
        // int64_t pos = AppEncoder_GetPosition();
        // if (pos!= 0 && pos % (11*90*2) == 0)
        // {
        //     AppMotor_SetSpeed(0);
        //     motor_pwm = 0;
        //     test_to_reach_full_rotation+=1;
        //     printf("\n pos%%11 reached %lld - test_to_full_rot = %lld", pos, test_to_reach_full_rotation);
        // }
        //  k_sleep(K_SECONDS(1));  // Keep main loop running
        //  printk(".");  // Simulate background process
     }
 
    //  while (1) 
    //  {
    //     // if(HalGpio_ReadPin(PIN_ENC_A) == 1)
    //     // {
    //     //     printk("H\n");
    //     // }
    //     // else if(HalGpio_ReadPin(PIN_ENC_A) == 0)
    //     // {
    //     //     printk("L\n");
    //     // }
    //     //  ret = HalGpio_TogglePin(PIN_LED1_DEVKIT);
    //     // HalGpio_WritePin (PIN_LED1_DEVKIT, 0);
    //     // UtilGen_delay_ms(SLEEP_TIME_MS);
    //     // HalGpio_WritePin (PIN_LED1_DEVKIT, 1);
    //     // UtilGen_delay_ms(SLEEP_TIME_MS);
    //  }
}
```

## src/App.h
```c
/******************************************************************************/

/**
 *  \file    App.h
 *  \author  https://github.com/gwyacnt/
 *  \brief   App component definitions
 *
 *  \remarks 
 */

 #ifndef __APP_H__
 #define __APP_H__

 void AppProcess(void);
 
 #endif
```

## src/AppEncoder.c
```c
#include <stdint.h>
#include <stdio.h>
#include "AppEncoder.h"
#include "HalGpio.h"

#define ENCODER_PULSES_PER_UNGEARED_REVOLUTIONS 11
#define ENCODER_GEAR_RATIO                      90
#define EDGE_DETECTION_MULTIPLIER               2
#define INTERRUPTS_PER_FULL_REVOLUTION          (ENCODER_PULSES_PER_UNGEARED_REVOLUTIONS*ENCODER_GEAR_RATIO*EDGE_DETECTION_MULTIPLIER)


static int64_t motor_position = 0;

void AppEncoder_Init (void)
{
    // Register GPIO encoder pin callback function
    HalGpio_RegisterCallback(AppEncoder_InterruptHandler);
}

int64_t AppEncoder_GetPosition  (void)
{
    return motor_position;
}

void AppEncoder_SetPosition  (int64_t pos)
{
    motor_position = pos;
}

int64_t AppEncoder_ConvertNumOfRotationsToPos (int64_t pos_in_number_of_rotations)
{
    return pos_in_number_of_rotations*INTERRUPTS_PER_FULL_REVOLUTION;
}


void AppEncoder_InterruptHandler (void)
{
    int enc_a = HalGpio_ReadPin(PIN_ENC_A);
    int enc_b = HalGpio_ReadPin(PIN_ENC_B);

    // printf("\nEncoder Interrupt enc_a pin: %d, enc_b pin: %d \n", enc_a, enc_b);

    // Determine direction
    if (enc_a == enc_b) 
    {
        motor_position--;  // Counterclockwise
        // if (motor_position!= 0 && motor_position % INTERRUPTS_PER_FULL_REVOLUTION == 0)
        // {
        //     motor_position_full_revs-=1;
        // }
    } else 
    {
        motor_position++;  // Clockwise
        // if (motor_position!= 0 && motor_position % INTERRUPTS_PER_FULL_REVOLUTION == 0)
        // {
        //     motor_position_full_revs+=1;
        // }
    }
    // printf("\n%lld \n", motor_position);
}



/*
1. Encoder Pulses Per Motor Shaft Rotation (PPR)
From your motor's spec sheet (in the image you shared):

Encoder resolution: 11 PPR (Pulses Per Revolution of the motor shaft)

It's a quadrature encoder (AB phase) → each edge gives an interrupt

✅ 2. Quadrature Mode: How Many Counts per Pulse?
If you're using:

Mode	Counts per PPR
Only rising edge of A	11 (1x)
Both edges of A	22 (2x)
All edges of A and B	44 (4x) ← most accurate
👉 If your code triggers on both edges of A and reads B, you’re likely running in 2x mode.

✅ 3. Gear Reduction
From your image:

Gearbox is applied after encoder

If gear ratio is e.g. 1:30, then:

Total Interrupts per Shaft Rotation
=
PPR
×
Gear Ratio
×
Quadrature Multiplier
Total Interrupts per Shaft Rotation=PPR×Gear Ratio×Quadrature Multiplier
Example:
11 PPR

Gear ratio: 1:30

Using both edges of A → multiplier = 2

Interrupts per full output shaft rotation
=
11
×
30
×
2
=
660
 interrupts
Interrupts per full output shaft rotation=11×30×2= 
660 interrupts
​
 
If using 4x decoding:

11
×
30
×
4
=
1320
 counts
11×30×4= 
1320 counts
​

*/
```

## src/AppEncoder.h
```c
/******************************************************************************/

/**
 *  \file    AppEncoder.h
 *  \author  https://github.com/gwyacnt/
 *  \brief   App Encoder component definitions
 *
 *  \remarks 
 */

#ifndef __APP_ENCODER_H__
#define __APP_ENCODER_H__

#include <stdint.h>

void       AppEncoder_Init         (void);
int64_t    AppEncoder_GetPosition  (void);
int64_t AppEncoder_GetNumberOfFullRotations  (void);
void       AppEncoder_SetPosition  (int64_t pos);
int64_t AppEncoder_ConvertNumOfRotationsToPos (int64_t pos_in_number_of_rotations);
void       AppEncoder_InterruptHandler  (void);

#endif
```

## src/AppMotor.c
```c
/******************************************************************************/

/**
 *  \file    AppMotor.c
 *  \author  https://github.com/gwyacnt/
 *  \brief   AppMotor component implementation
 *
 *  \remarks https://curiousscientist.tech/blog/dc-motor-position-control-using-pid
*/

// Standard lib includes
#include <math.h>
#include <stdint.h>
#include <stdio.h>
#include <string.h>
#include <stdlib.h>

// Target specific includes
#include <zephyr/kernel.h>

// GWYACNT includes
#include "AppMotor.h"
#include "AppEncoder.h"
#include "HalGpio.h"
#include "HalPwm.h"

/******************************************************************************/
/* Local defines and types                                                    */
/******************************************************************************/


/******************************************************************************/
/* Local data                                                                 */
/******************************************************************************/
/* PID parameters */
static double PID_PROPORTIONAL_COEFF = 1.35; //k_p = 0.5
static double PID_INTEGRAL_COEFF = 0.01; //k_d = 1
static double PID_DERIVATIVE_COEFF = 0.00005; //k_i = 3
static double  errorIntegral;    // integral term - Newton-Leibniz, notice, this is a running sum!
static double  previousError;    // save the error for the next iteration to get the difference (for edot)
static int64_t previousTime;

/* Motor Driving parameters */
static int64_t setpoint;
static uint8_t maxSpeed_percent = 40;
static uint8_t minSpeed_percent = 20;

/******************************************************************************/
/* Local function prototypes                                                  */
/******************************************************************************/

/******************************************************************************/
/* Exported functions                                                         */
/******************************************************************************/
void AppMotor_SetPidCoeffs (double P, double I, double D)
{
    PID_PROPORTIONAL_COEFF = P;
    PID_INTEGRAL_COEFF     = I;
    PID_DERIVATIVE_COEFF   = D;
}
/******************************************************************************/

void AppMotor_SetTarget (int64_t target_setpoint)
{
    setpoint = target_setpoint;
}
/******************************************************************************/

int64_t AppMotor_GetTarget (void)
{
    return setpoint;
}
/******************************************************************************/

void AppMotor_DriveMotorTask (void)
{
    printf("\n TASK: targetPosition: %f", (double)setpoint);

    double control_pwm, errorValue;
    MotorDirection_enum_t motorDirection;

    AppMotor_CalculatePID(&control_pwm, &errorValue);
    //Determine speed and direction based on the value of the control signal
    //direction
    if (control_pwm < 0) //negative value: CCW
    {
        motorDirection = MOTOR_DIRECTION_CCW;
    }
    else if (control_pwm > 0) //positive: CW
    {
        motorDirection = MOTOR_DIRECTION_CW;
    }
    else //0: STOP - this might be a bad practice when you overshoot the setpoint
    {
        motorDirection = MOTOR_DIRECTION_STOPPED;
    }

    //---------------------------------------------------------------------------
    //Speed
    //PWM values cannot be negative and have to be integers
    int PWMValue = (int)fabs(control_pwm);
    printf("\n TASK: PWMValue after fabs: %f", (float)PWMValue);

    // 0-100
    // PWMValue = PWMValue/UINT64_MAX *100;

    // checking speed limits
    if (PWMValue > maxSpeed_percent)
    {
        PWMValue = maxSpeed_percent;
    }

    if (PWMValue < minSpeed_percent && errorValue != 0)
    {
        PWMValue = minSpeed_percent;
    }
    //A little explanation for the "bottom capping":
    //Under a certain PWM value, there won't be enough current flowing through the coils of the motor
    //Therefore, despite the fact that the PWM value is set to the "correct" value, the motor will not move
    //The above value is an empirical value, it depends on the motors perhaps, but 30 seems to work well in my case

    /*  Set Direction and motor speed  */
    if (motorDirection == MOTOR_DIRECTION_CCW) //-1 == CCW
    {
        HalGpio_WritePin(PIN_MOTOR_R_EN, 1);
        HalGpio_WritePin(PIN_MOTOR_L_EN, 0);
        PWM_SetDutyCycle(HAL_PWM_CHANNEL_MOTOR_R_PWM, PWMValue);
    }
    else if (motorDirection == MOTOR_DIRECTION_CW) // == 1, CW
    {
        HalGpio_WritePin(PIN_MOTOR_R_EN, 0);
        HalGpio_WritePin(PIN_MOTOR_L_EN, 1);
        PWM_SetDutyCycle(HAL_PWM_CHANNEL_MOTOR_L_PWM, PWMValue);
    }
    else // == MOTOR_DIRECTION_STOPPED, stop/break
    {
        HalGpio_WritePin(PIN_MOTOR_R_EN, 0);
        HalGpio_WritePin(PIN_MOTOR_L_EN, 0);
        PWMValue = 0;
        PWM_SetDutyCycle(HAL_PWM_CHANNEL_MOTOR_R_PWM, PWMValue);
        PWM_SetDutyCycle(HAL_PWM_CHANNEL_MOTOR_L_PWM, PWMValue);
        //In this block we also shut down the motor and set the PWM to zero
    }

    //----------------------------------------------------
    //Optional printing on the terminal to check what's up
    printf("\n TASK: errorValue: %f",errorValue);
    printf("\n TASK: PWMValue: %f", (float)PWMValue);
}
/******************************************************************************/

/*
returns:
    double controlSignal;     // u - Also called as process variable (PV)
    double errorValue;        // Current position - target position (or setpoint)
*/
void AppMotor_CalculatePID (double* controlSignal, double* errorValue)
{
    
    double edot;             // edot = de/dt - derivative term
    int64_t motor_position; 

    /*  Determining the elapsed time   */
    // current time
    int64_t currentTime = k_uptime_get();
    // time difference in seconds
    double deltaTime_s = (currentTime - previousTime) / 1000.0;
    // save the current time for the next iteration to get the time difference
    previousTime = currentTime; 

    /*  Calculate PID parameters   */
    //Current position - target position (or setpoint)
    motor_position = AppEncoder_GetPosition();
    *errorValue = motor_position - setpoint; 
    //edot = de/dt - derivative term
    edot = (*errorValue - previousError) / deltaTime_s;
    // integral term - Newton-Leibniz, notice, this is a running sum!
    errorIntegral = errorIntegral + (*errorValue * deltaTime_s); 
    // final sum, proportional term also calculated here
    *controlSignal = (PID_PROPORTIONAL_COEFF * *errorValue) + (PID_DERIVATIVE_COEFF * edot) + (PID_INTEGRAL_COEFF * errorIntegral); 
    //save the error for the next iteration to get the difference (for edot)
    previousError = *errorValue; 

    //----------------------------------------------------
    //Optional printing on the terminal to check what's up
    printf("\n PID: motorPosition: %f", (double)motor_position);
    printf("\n PID: controlSignal: %f", *controlSignal);
    printf("\n PID: errorValue: %f", *errorValue);
}


/******************************************************************************/
void  AppMotor_SetSpeed(int speed_percent)
{
    
    if (speed_percent == 0) // Stop
    {
        HalGpio_WritePin(PIN_MOTOR_R_EN, 0);
        HalGpio_WritePin(PIN_MOTOR_L_EN, 0);
        // HAL_PWM_CHANNEL_MOTOR_R_PWM = 1,                                                 
        // HAL_PWM_CHANNEL_MOTOR_L_PWM = 2,    
        PWM_SetDutyCycle(HAL_PWM_CHANNEL_MOTOR_R_PWM, 0);
        PWM_SetDutyCycle(HAL_PWM_CHANNEL_MOTOR_L_PWM, 0);
        printf("\nStopping");
    }
    else if( speed_percent > 0 ) // Clockwise
    {
        // Cap speed
        if (speed_percent > 100) speed_percent = 100;
        // Disable CCW
        HalGpio_WritePin(PIN_MOTOR_L_EN, 0);
        PWM_SetDutyCycle(HAL_PWM_CHANNEL_MOTOR_L_PWM, 0);
        // Set CW
        HalGpio_WritePin(PIN_MOTOR_R_EN, 1);
        PWM_SetDutyCycle(HAL_PWM_CHANNEL_MOTOR_R_PWM, speed_percent);
        printf("\nClockwise with %d speed", speed_percent);
    }
    else if( speed_percent < 0)
    {
        // Cap speed
        if (speed_percent < -100) speed_percent = -100;
        // Disable CW
        HalGpio_WritePin(PIN_MOTOR_R_EN, 0);
        PWM_SetDutyCycle(1, 0);
        // Set CCW
        speed_percent = speed_percent*-1;
        HalGpio_WritePin(PIN_MOTOR_L_EN, 1);
        PWM_SetDutyCycle(2, speed_percent);
        printf("\nCounter-clockwise with %d speed", speed_percent);
    }
}
/******************************************************************************/
/******************************************************************************/
/* Local functions                                                            */
/******************************************************************************/

/**
 * \}
 * End of file.
 */
```

## src/AppMotor.h
```c
/******************************************************************************/

/**
 *  \file    AppMotor.h
 *  \author  https://github.com/gwyacnt/
 *  \brief   App Motor component definitions
 *
 *  \remarks 
 */

#ifndef __APP_MOTOR_H__
#define __APP_MOTOR_H__

#include <stdint.h>
#include <stdbool.h>

/******************************************************************************/
/* Exported defines and types                                                 */
/******************************************************************************/
typedef enum MotorDirection_tag
{
    MOTOR_DIRECTION_CW,
    MOTOR_DIRECTION_CCW,
    MOTOR_DIRECTION_STOPPED
} MotorDirection_enum_t;

/******************************************************************************/
/* Exported data                                                              */
/******************************************************************************/

/******************************************************************************/
/* Exported functions                                                         */
/******************************************************************************/
void          AppMotor_SetTarget         (int64_t setpoint);
int64_t       AppMotor_GetTarget         (void);
void          AppMotor_Halt              (void);
void          AppMotor_CalculatePID      (double* controlSignal, double* errorValue);
void          AppMotor_SetPidCoeffs      (double P, double I, double D);
void          AppMotor_DriveMotorTask    (void);
void          AppMotor_SetSpeed          (int speed_percent);
#endif /* defined __APP_MOTOR_H__ */
```

## src/HalGpio.c
```c
/******************************************************************************/

/**
 *  \file    HalGpio.c
 *  \author  https://github.com/gwyacnt/
 *  \brief   GPIO component implementation
 *
 *  \remarks 
*/

// Standard lib includes
#include <stdint.h>
#include <stdio.h>
#include <string.h>
#include <stdlib.h>

// Target specific includes
#include <zephyr/kernel.h>
#include <zephyr/drivers/gpio.h>
#include <zephyr/irq.h>
#include <zephyr/sys/printk.h>
// GWYACNT includes
#include "HalGpio.h"
#include "UtilGen.h"
#include "SrvMenu.h"
/******************************************************************************/
/* Local defines and types                                                    */
/******************************************************************************/
 typedef enum HAL_GPIO_PIN_MODE_tag
 {
    HAL_GPIO_MODE_OUTPUT = 0,
    HAL_GPIO_MODE_INPUT  = 1
 } halGpioPinMode_enum;

 typedef enum HAL_GPIO_PIN_PULL_tag
 {
    HAL_GPIO_PULL_UP    = 0,
    HAL_GPIO_PULL_DOWN  = 1,
    HAL_GPIO_FLOATING   = 2
 }halGpioPinPullMode_enum;

/******************************************************************************/
/* Local function prototypes                                                  */
/******************************************************************************/
 static void configure_pin(HalGpio_Pin gpio_pin, halGpioPinMode_enum mode, halGpioPinPullMode_enum gpio_pullMode, uint8_t interrupt_en);
 static void encoder_handler(const struct device *dev, struct gpio_callback *cb, uint32_t pins);
 
/******************************************************************************/
/* Local data                                                                 */
/******************************************************************************/
 // GPIO Device Bindings
 static const struct device *gpio_0_dev = DEVICE_DT_GET(DT_NODELABEL(gpio0));
 static const struct device *gpio_1_dev = DEVICE_DT_GET(DT_NODELABEL(gpio1));
 static struct gpio_callback enc_a_cb;
 static struct gpio_callback enc_b_cb;
 static volatile int32_t motor_position = 0;  // Motor position counter
 static HalGpioCallback user_callback = NULL;

/******************************************************************************/
/* Exported data                                                              */
/******************************************************************************/
// Pin assignments
 HalGpio_Pin PIN_LED1_DEVKIT = {.port=0, .pin=28};
 HalGpio_Pin PIN_LED2_DEVKIT = {.port=0, .pin=29};
 HalGpio_Pin PIN_LED3_DEVKIT = {.port=0, .pin=30};
 HalGpio_Pin PIN_LED4_DEVKIT = {.port=0, .pin=31};
 HalGpio_Pin PIN_MOTOR_R_EN  = {.port=0, .pin=25};
 HalGpio_Pin PIN_MOTOR_L_EN  = {.port=0, .pin=26};
 HalGpio_Pin PIN_MOTOR_R_PWM = {.port=0, .pin=04};
 HalGpio_Pin PIN_MOTOR_L_PWM = {.port=0, .pin=05};
 HalGpio_Pin PIN_ENC_A       = {.port=0, .pin=23};
 HalGpio_Pin PIN_ENC_B       = {.port=0, .pin=24};


 // pin ID param (for write pin action)
SRVMENU_ACTIONPARAMSTR(write_pin, static char, 3, pin_id, "GPIO Pin ID (examples: A1, b15, c0, C2..etc)");
// pin state param (for write pin action)
SRVMENU_ACTIONPARAMINT(write_pin, static int, pin_state, "GPIO Pin state (0 or 1)", MENU_VALUE_FMT_LIMITS, 0, 1);
// write pin action
SRVMENU_ACTION_BEGIN(write_pin) \
SRVMENU_ACTION_PARAM(write_pin, pin_id      , 'p') \
SRVMENU_ACTION_PARAM(write_pin, pin_state   , 's') \
SRVMENU_ACTION_END(write_pin, "Write GPIO pin");

// pin ID param (for read pin action)
SRVMENU_ACTIONPARAMSTR(read_pin, static char, 3, pin_id, "GPIO Pin ID (examples: A1, b15, c0, C2..etc)");
// read pin action
SRVMENU_ACTION_BEGIN(read_pin) \
SRVMENU_ACTION_PARAM(read_pin, pin_id      , 'p') \
SRVMENU_ACTION_END(read_pin, "Read GPIO pin");

 /* GPIO Menu */
static const srvMenuList_ts gpioDrvMenu[] =
{
   {&elem_write_pin,   (int)'w'}
  ,{&elem_read_pin ,   (int)'r'}
  ,{NULL,0}
};
const srvMenuElement_ts elemGpioDrv = {"gpio", "GPIO driver", &SRV_MENU_TYPE_MENU, gpioDrvMenu};

 /******************************************************************************/
 /* Exported functions                                                         */
 /******************************************************************************/
 /**
   * @brief GPIO Initialization Function
   * @param None
   * @retval None
   */
 void HalGpio_Init(void)
 {  
    // Set input GPIO pins
    configure_pin(PIN_ENC_A, HAL_GPIO_MODE_INPUT, HAL_GPIO_PULL_UP, 1);
    configure_pin(PIN_ENC_B, HAL_GPIO_MODE_INPUT, HAL_GPIO_PULL_UP, 1);
    // Set up interrupt on ENC_A
    gpio_pin_interrupt_configure(gpio_0_dev, PIN_ENC_A.pin, GPIO_INT_EDGE_BOTH);
    gpio_init_callback(&enc_a_cb, encoder_handler, (1UL << (PIN_ENC_A.pin)));
    gpio_add_callback(gpio_0_dev, &enc_a_cb);

    // Enable R and L pins
    configure_pin(PIN_MOTOR_R_EN, HAL_GPIO_MODE_OUTPUT, HAL_GPIO_PULL_UP, 0);
    configure_pin(PIN_MOTOR_L_EN, HAL_GPIO_MODE_OUTPUT, HAL_GPIO_PULL_UP, 0);

    // Set PWM pins
    
    
    // Debugging LEDs
    // https://docs.nordicsemi.com/bundle/ug_nrf5340_dk/page/UG/dk/hw_buttons_leds.html
    configure_pin(PIN_LED1_DEVKIT, HAL_GPIO_MODE_OUTPUT, HAL_GPIO_PULL_DOWN, 0);
    configure_pin(PIN_LED2_DEVKIT, HAL_GPIO_MODE_OUTPUT, HAL_GPIO_PULL_DOWN, 0);
    configure_pin(PIN_LED3_DEVKIT, HAL_GPIO_MODE_OUTPUT, HAL_GPIO_PULL_DOWN, 0);
    configure_pin(PIN_LED4_DEVKIT, HAL_GPIO_MODE_OUTPUT, HAL_GPIO_PULL_DOWN, 0);

    
    
    // HalGpio_WritePin (PIN_LED2_DEVKIT, 0);
    // HalGpio_WritePin (PIN_LED3_DEVKIT, 0);
 }
 
 /******************************************************************************/
 
 int HalGpio_ReadPin (HalGpio_Pin gpio_pin)
 {
    if(gpio_pin.port == 0)
    {
       return gpio_pin_get(gpio_0_dev, (gpio_pin_t)gpio_pin.pin);
    }
    else if(gpio_pin.port == 1)
    {
       return gpio_pin_get(gpio_1_dev, (gpio_pin_t)gpio_pin.pin);
    }
    else
    {
       return UTIL_GEN_ERROR_GENERIC;
    }
 }
 
 /******************************************************************************/
 
 int HalGpio_WritePin (HalGpio_Pin gpio_pin, uint32_t level)
 {   
     if(gpio_pin.port == 0)
     {
        return gpio_pin_set(gpio_0_dev, (gpio_pin_t)gpio_pin.pin, (int)level);
     }
     else if(gpio_pin.port == 1)
     {
        return gpio_pin_set(gpio_1_dev, (gpio_pin_t)gpio_pin.pin, (int)level);
     }
     else
     {
        return UTIL_GEN_ERROR_GENERIC;
     }
 }
 
 /******************************************************************************/
int HalGpio_TogglePin(HalGpio_Pin gpio_pin)
{
    if(gpio_pin.port == 0)
    {
        return gpio_pin_toggle(gpio_0_dev, (gpio_pin_t)gpio_pin.pin);
    }
    else if(gpio_pin.port == 1)
    {
        return gpio_pin_toggle(gpio_1_dev, (gpio_pin_t)gpio_pin.pin);
    }
    else
    {
        return UTIL_GEN_ERROR_GENERIC;
    }
}
/******************************************************************************/

void  HalGpio_RegisterCallback   (HalGpioCallback callback)
{
    user_callback = callback;
}
/******************************************************************************/

void  HalGpio_UnregisterCallback (void)
{
    user_callback = NULL;
}

/******************************************************************************/
/* Local functions                                                            */
/******************************************************************************/
/**
 * @brief Configure a GPIO pin with specified settings
 * 
 * @param gpio_pin       GPIO port and pin number
 * @param mode           GPIO mode (0: Input, 1: Output)
 * @param gpio_pullMode  Enable pull-up resistor (0: pullup, 1: pull down, 2: floating)
 * @param interrupt_en   Enable interrupt (1: Enable, 0: Disable)
 */
static void configure_pin(HalGpio_Pin gpio_pin, halGpioPinMode_enum mode, halGpioPinPullMode_enum gpio_pullMode, uint8_t interrupt_en)
{
    if (!device_is_ready(gpio_0_dev)) 
    {
        // LOG_ERR("GPIO device not ready!");
        return;
    }

    int flags = 0;

    // Set mode: Input or Output
    if (mode == HAL_GPIO_MODE_OUTPUT) 
    {
        flags |= GPIO_OUTPUT_INACTIVE;// | GPIO_ACTIVE_LOW;  // Set output LOW initially
    } 
    else 
    {
        flags |= GPIO_INPUT ;
    }

    // Configure Pull-up/Pull-down
    if (gpio_pullMode == HAL_GPIO_PULL_UP) 
    {
        flags |= GPIO_PULL_UP;
    }
    else if (gpio_pullMode == HAL_GPIO_PULL_DOWN) 
    {
        flags |= GPIO_PULL_DOWN;
    }
    else
    {
        // do nothing
    }

    // Configure Interrupts
    if (interrupt_en) 
    {
        flags |= GPIO_INT_ENABLE | GPIO_INT_EDGE ;
    }

    // Apply Configuration
    int ret = 0xE;
    if(gpio_pin.port == 0)
    {
    ret = gpio_pin_configure(gpio_0_dev, (gpio_pin_t)gpio_pin.pin, flags);
    }
    else if(gpio_pin.port == 1)
    {
    ret = gpio_pin_configure(gpio_1_dev, (gpio_pin_t)gpio_pin.pin, flags);
    }

    if (ret < 0) 
    {
        // LOG_ERR("Failed to configure GPIO pin %llu", pin_num);
    } else 
    {
        // LOG_INF("Configured pin %llu as %s", pin_num, mode ? "OUTPUT" : "INPUT");
    }
}
/******************************************************************************/

static void encoder_handler(const struct device *dev, struct gpio_callback *cb, uint32_t pins)
{
    if (user_callback) 
    {
        user_callback();  // Execute user-defined callback
    }
}

/******************************************************************************/
static int action_write_pin(const srvMenuElement_ts * elm, int opt)
{

    printf("#Writing GPIO pin %s with %d.\n", action_write_pin_pin_id, action_write_pin_pin_state);
    printf("\n>");

    return 0;
}

/******************************************************************************/

static int action_read_pin(const srvMenuElement_ts * elm, int opt)
{
    // Call the HalScsGpio_ReadPin function
    printf(">P%s=UNKNONW\n", action_read_pin_pin_id);
    printf("\n>");

    return 0;
}
/**
 * \}
 * End of file.
 */
```

## src/HalGpio.h
```c
/******************************************************************************/

/**
 *  \file    HalGpio.h
 *  \author  https://github.com/gwyacnt/
 *  \brief   GPIO component definitions
 *
 *  \remarks 
 */

#ifndef __HAL_GPIO_H__
#define __HAL_GPIO_H__
 
#include <stdint.h>
#include <stdbool.h>
#include "SrvMenu.h"

 /******************************************************************************/
 /* Exported defines and types                                                 */
 /******************************************************************************/
 typedef void (*HalGpioCallback)(void);  // Callback function type

 typedef struct HalGpio_Pin_tag
 {
    uint8_t port;
    uint8_t pin;
 }HalGpio_Pin;

 // GPIO output pins
// GPIO output pin declarations (use extern to prevent multiple definitions)
extern HalGpio_Pin PIN_LED1_DEVKIT; // P0.28
extern HalGpio_Pin PIN_LED2_DEVKIT; // P0.29
extern HalGpio_Pin PIN_LED3_DEVKIT; // P0.30
extern HalGpio_Pin PIN_LED4_DEVKIT; // P0.31

//R_EN and L_EN must be set HIGH to enable movement.
extern HalGpio_Pin PIN_MOTOR_R_EN; 
extern HalGpio_Pin PIN_MOTOR_L_EN; 

//RPWM and LPWM are controlled using PWM signals to adjust speed and direction.
extern HalGpio_Pin PIN_MOTOR_R_PWM; 
extern HalGpio_Pin PIN_MOTOR_L_PWM; 

// OUT C1/A and OUT C2/B provide quadrature signals to track motor position & speed.
// These pins are read using interrupts or timers in nRF5340.
extern HalGpio_Pin PIN_ENC_A;       
extern HalGpio_Pin PIN_ENC_B;       
/******************************************************************************/
/* Exported data                                                              */
/******************************************************************************/
extern const srvMenuElement_ts elemGpioDrv;

/******************************************************************************/
/* Exported functions                                                         */
/******************************************************************************/
void          HalGpio_Init               (void);
int           HalGpio_ReadPin            (HalGpio_Pin gpio_pin);
int           HalGpio_WritePin           (HalGpio_Pin gpio_pin, uint32_t level);
int           HalGpio_TogglePin          (HalGpio_Pin gpio_pin);
void          HalGpio_RegisterCallback   (HalGpioCallback callback);
void          HalGpio_UnregisterCallback (void);

#endif /* defined __HAL_GPIO_H__ */
```

## src/HalPwm.c
```c
#include "HalPwm.h"
#include "HalGpio.h"
#include <nrfx_pwm.h>
#include <stdio.h>

#define PWM_INST_IDX 0
#define PWM_PERIOD 640 //High-Resolution Control (Precise Speed Control)

static nrfx_pwm_t pwm_instance = NRFX_PWM_INSTANCE(PWM_INST_IDX);

// Sequence data (NRF PWM requires sequences for duty cycles)
static nrf_pwm_values_common_t pwm_seq_values[HAL_PWM_N_OF_CONNECTED_CHANNELS];
static nrf_pwm_sequence_t pwm_seq = {
    .values.p_common = pwm_seq_values,
    .length = NRF_PWM_VALUES_LENGTH(pwm_seq_values),
    .repeats = 0,
    .end_delay = 0
};


void PWM_Init(void) 
{
    nrfx_err_t status;
    (void)status;

    /* The DC motor driver BTS7960 is capable of PWM up to 25 kHz.
    Frequency = (16MHz/Presccaler) * top_value
    25000     = (16000000/Prescaler) * top_value
    If Prescaler = 1
    then top_value = 640
    */
    
    nrfx_pwm_config_t config = {                                                               
        .output_pins   = {                                          
            PIN_LED3_DEVKIT.pin,
            PIN_MOTOR_R_PWM.pin,                                                 
            PIN_MOTOR_L_PWM.pin,                                                 
            PIN_LED4_DEVKIT.pin,                                                 
        },
        .pin_inverted  = {                                          
            false,
            false,
            false,
            false,
        },
        .irq_priority  = NRFX_PWM_DEFAULT_CONFIG_IRQ_PRIORITY,      
        .base_clock    = PWM_PRESCALER_PRESCALER_DIV_1, //NRF_PWM_CLK_1MHz,                          
        .count_mode    = NRF_PWM_MODE_UP,                           
        .top_value     = PWM_PERIOD,                                      
        .load_mode     = NRF_PWM_LOAD_INDIVIDUAL,  // Allow independent duty cycles //NRF_PWM_LOAD_COMMON,                       
        .step_mode     = NRF_PWM_STEP_AUTO,                         
        .skip_gpio_cfg = false                                      
    };
    status = nrfx_pwm_init(&pwm_instance, &config, NULL, NULL);
    NRFX_ASSERT(status == NRFX_SUCCESS);

    // Start continuous playback
    nrfx_pwm_simple_playback(&pwm_instance, &pwm_seq, 1, NRFX_PWM_FLAG_LOOP);
}

// Set PWM Duty Cycle (0-100%)
void PWM_SetDutyCycle(HAL_PWM_CHANNEL_t channel, uint8_t duty_cycle) 
{
    if (channel < HAL_PWM_N_OF_CONNECTED_CHANNELS)
    {
        if (duty_cycle > 100) duty_cycle = 100;
        pwm_seq_values[channel] = (duty_cycle * PWM_PERIOD) / 100;  // Convert to pulse width
        //nrfx_pwm_simple_playback(&pwm_instance, &pwm_seq, 1, NRFX_PWM_FLAG_LOOP);
        // No need to restart playback if already running
        nrfx_pwm_sequence_update(&pwm_instance, 0, &pwm_seq);

        printf("\nPWM Channel %d: Duty Cycle = %d%%", channel, duty_cycle);
    }    
    else
    {
        printf("\nInvalid operation | PWM_SetDutyCycle(%d, %d)", channel, duty_cycle);
    }
}
```

## src/HalPwm.h
```c
#ifndef PWM_H
#define PWM_H

#include <stdint.h>
#include <nrfx_pwm.h>


typedef enum
{
    HAL_PWM_CHANNEL_LED3_DEVKIT = 0,
    HAL_PWM_CHANNEL_MOTOR_R_PWM = 1,                                                 
    HAL_PWM_CHANNEL_MOTOR_L_PWM = 2,                                                 
    HAL_PWM_CHANNEL_LED4_DEVKIT = 3,  
    HAL_PWM_N_OF_CONNECTED_CHANNELS
} HAL_PWM_CHANNEL_t;

void PWM_Init(void);
void PWM_SetDutyCycle(HAL_PWM_CHANNEL_t channel, uint8_t duty_cycle);

#endif // PWM_H
```
